## config/west.yml
```yaml
manifest:
  defaults:
    revision: v0.3
  remotes:
    - name: zmkfirmware
      url-base: https://github.com/zmkfirmware
    - name: zlee1
      url-base: https://github.com/zlee1
    # Additional modules containing boards/shields/custom code can be listed here as well
    # See https://docs.zephyrproject.org/3.2.0/develop/west/manifest.html#projects
    # - name: mctechnology17
    #   url-base: https://github.com/mctechnology17
  projects:
    - name: zmk
      remote: zlee1
      revision: rgb_customization
      import: app/west.yml
    # - name: zmk-nice-oled
    #   remote: mctechnology17
    #   revision: main
  self:
    path: config
```
